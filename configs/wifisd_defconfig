## configs/wifisd_defconfig
```kconfig
BR2_arm=y
BR2_STRIP_sstrip=y
BR2_KERNEL_HEADERS_VERSION=y
BR2_DEFAULT_KERNEL_VERSION="2.6.32.26"
BR2_ROOTFS_DEVICE_TABLE="board/wifisd/device_table.txt"
BR2_ROOTFS_STATIC_DEVICE_TABLE="board/wifisd/device_table_dev.txt"
BR2_ROOTFS_OVERLAY="board/wifisd/fs-overlay"
BR2_ROOTFS_POST_BUILD_SCRIPT="board/wifisd/post-build.sh"
BR2_ROOTFS_POST_IMAGE_SCRIPT="board/wifisd/post-image.sh"
BR2_PACKAGE_BUSYBOX_CONFIG="board/wifisd/busybox-1.21.1.config"
BR2_PACKAGE_LUA=y
BR2_PACKAGE_LUA_INTERPRETER_READLINE=y
BR2_PACKAGE_LUACJSON=y
BR2_PACKAGE_LUAEXPAT=y
BR2_PACKAGE_LUAPOSIX=y
BR2_PACKAGE_XAVANTE=y
BR2_PACKAGE_ZLIB=y
BR2_PACKAGE_DROPBEAR=y
BR2_PACKAGE_RSYNC=y
BR2_PACKAGE_WIRELESS_TOOLS=y
BR2_PACKAGE_WPA_SUPPLICANT=y
BR2_PACKAGE_WPA_SUPPLICANT_EAP=y
BR2_PACKAGE_WPA_SUPPLICANT_CLI=y
BR2_PACKAGE_WPA_SUPPLICANT_PASSPHRASE=y
BR2_PACKAGE_WPA_SUPPLICANT_AP_SUPPORT=y
BR2_PACKAGE_WPA_SUPPLICANT_WPS=y
BR2_PACKAGE_DTACH=y
BR2_TARGET_ROOTFS_CPIO=y
BR2_TARGET_ROOTFS_CPIO_GZIP=y
BR2_TARGET_ROOTFS_TAR_GZIP=y
BR2_GLOBAL_PATCH_DIR=../kcard-buildroot/patches
```
